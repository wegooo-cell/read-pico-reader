/* Generated by tools/gen_ui_locale.py; do not edit. */
static const ui_locale_pair_t s_pairs[] = {
    {" · 剩余 "," · Remaining "},
    {" · 单文件 ≤ 1 MB"," · Maximum 1 MB per file"},
    {" · 失败 "," · Failed "},
    {" · 已配对"," · Paired"},
    {"%+d px · 复位","%+d px · Reset"},
    {"%d / %d · 上下滑动切换","%d / %d · Swipe up/down to switch"},
    {"%d 张 · JPG / PNG","%d images · JPG / PNG"},
    {"%d 张 · 透明 PNG","%d images · Transparent PNG"},
    {"%d 张图片","%d images"},
    {"%d/%d · 上下滑动预览","%d/%d · Swipe up/down to preview"},
    {"%d/%d 页 · 已选 %u 本","%d/%d · %u selected"},
    {"%d年%d月","%d/%d"},
    {"%d年%d月%d日","%d/%d/%d"},
    {"%d月%d日","%d/%d"},
    {"%d本书 · %02d/%02d","%d books · %02d/%02d"},
    {"%lu 分钟","%lu min"},
    {"%lu 次","%lu turns"},
    {"%s %u 本图书？","%s %u books?"},
    {"%s · 共 %u 页","%s · %u pages"},
    {"%s · 剩余 %.1f MB%s","%s · %.1f MB free%s"},
    {"%s 副本 %d%s","%s copy %d%s"},
    {"%s 副本%s","%s copy%s"},
    {"%s 可用","%s free"},
    {"%u / %u 页","%u / %u pages"},
    {"%u 个 · %u/%u 页","%u networks · %u/%u"},
    {"%u 分钟","%u min"},
    {"%u 卷","%u volumes"},
    {"%u 节","%u sections"},
    {"+ 导入","+ Import"},
    {"1  在电脑上等待复制完成","1  Wait for the computer to finish copying"},
    {"1 分钟","1 min"},
    {"1 小时","1 hour"},
    {"10 分钟","10 min"},
    {"10页 »","10 pages »"},
    {"1字","1 ch"},
    {"2  安全弹出 SD_CARD，再结束读卡","2  Eject SD_CARD safely, then end USB mode"},
    {"24 小时","24 hours"},
    {"2字","2 ch"},
    {"30 天前","30 days ago"},
    {"3字","3 ch"},
    {"5 分钟","5 min"},
    {"8 小时","8 hours"},
    {"AI 快捷键","AI shortcuts"},
    {"BOOT 切换失败：%s","Could not enter BOOT: %s"},
    {"BOOT 刷机","BOOT flashing"},
    {"EPUB、TXT 书籍","EPUB, TXT books"},
    {"En / 中","En / Zh"},
    {"OTA / TF 卡","OTA / TF card"},
    {"PNG无法加载，请更换图片","Cannot load PNG. Choose another image"},
    {"TF 卡","TF card"},
    {"TF 卡 pictures 文件夹中的 JPG / PNG 图片","JPG / PNG images in the TF card's pictures folder"},
    {"TF 卡 txt / epub 阅读","Read TXT / EPUB from the TF card"},
    {"TF 卡不可用","TF card unavailable"},
    {"TF 卡不可用或未选择文件","TF card unavailable or no files selected"},
    {"TF 卡不可用，请重新挂载后打开","TF card unavailable. Remount it before opening"},
    {"TF 卡升级","TF card update"},
    {"TF 卡图片 · JPG / PNG · 不超过 50 MB","TF card images · JPG / PNG · Up to 50 MB"},
    {"TF 卡容量  %.1f GB","TF card capacity  %.1f GB"},
    {"TF 卡尚未挂载","TF card not mounted"},
    {"TF 卡已移除","TF card removed"},
    {"TF 卡已移除，原存储已停用","TF card removed. Previous storage disabled"},
    {"TF 卡文件与传输","TF card files and transfer"},
    {"TF 卡根目录","TF card root"},
    {"TF 卡根目录未找到固件升级包","No firmware update in the TF card root"},
    {"TF余","TF free"},
    {"TF卡可用空间不足","Not enough free card space"},
    {"TTF / OTF 放入 TF 卡 fonts 文件夹后选择","Place TTF / OTF files in the TF card fonts folder, then select one"},
    {"TTF、OTF 字体","TTF, OTF fonts"},
    {"U 盘模式","USB drive"},
    {"U 盘模式导入字体","Import fonts in USB drive mode"},
    {"USB 写入未完成：%s，请在电脑弹出后重试","USB write incomplete: %s. Eject on the computer and retry"},
    {"USB 已连接，请在电脑点击“检查连接”","USB connected. Click Check connection on the computer"},
    {"USB 模式启动失败：%s","Could not start USB mode: %s"},
    {"USB 读卡","USB drive"},
    {"USB 读卡未开启","USB drive not started"},
    {"USB 连接时暂缓休眠","Sleep is deferred while USB is connected"},
    {"Wi-Fi 传输","Wi-Fi transfer"},
    {"WiFi 传书","Wi-Fi transfer"},
    {"WiFi 传书未启动","Wi-Fi transfer not started"},
    {"WiFi 使用中，蓝牙暂停","Wi-Fi in use; Bluetooth paused"},
    {"WiFi 对时完成，内部时钟已接管","Wi-Fi time synced. Internal clock is running"},
    {"WiFi 尚未连接，请稍后再试","Wi-Fi not connected. Retry shortly"},
    {"WiFi传书","Wi-Fi transfer"},
    {"WiFi连接失败，请重试","Wi-Fi connection failed. Retry"},
    {"Wifi/热点传书","Wi-Fi / hotspot transfer"},
    {"kiikoread 已关机","kiikoread is off"},
    {"kiikoread 热点","kiikoread hotspot"},
    {"pictures · 透明 PNG · 保留整张画布","pictures · Transparent PNG · Full canvas retained"},
    {"pictures 中暂无 JPG 或 PNG 图片","No JPG or PNG images in pictures"},
    {"{\"error\":\"SSID须为1至32字节；密码留空，或8至63个ASCII字符、64位十六进制密钥\"}","{\"error\":\"SSID must be 1–32 bytes; password empty, 8–63 ASCII characters or 64 hexadecimal digits\"}"},
    {"{\"error\":\"TF 卡尚未就绪\"}","{\"error\":\"TF card not ready\"}"},
    {"{\"error\":\"TF 卡空间不足或读写失败\"}","{\"error\":\"TF card full or read/write failed\"}"},
    {"{\"error\":\"保存网络失败，原配置未主动清除，请重试\"}","{\"error\":\"Could not save network. Previous configuration was not cleared. Retry\"}"},
    {"{\"error\":\"内存不足\"}","{\"error\":\"Not enough memory\"}"},
    {"{\"error\":\"同名文件已存在，请选择替换或跳过\",\"conflict\":true}","{\"error\":\"A file with this name exists. Choose replace or skip\",\"conflict\":true}"},
    {"{\"error\":\"图书不存在\"}","{\"error\":\"Book not found\"}"},
    {"{\"error\":\"图片已上传，但设置锁屏壁纸失败\"}","{\"error\":\"Image uploaded, but could not set lock wallpaper\"}"},
    {"{\"error\":\"存储空间不足或写入失败\"}","{\"error\":\"Insufficient storage or write failed\"}"},
    {"{\"error\":\"当前操作不支持该文件\"}","{\"error\":\"This operation does not support the file\"}"},
    {"{\"error\":\"接收配置超时，请重试\"}","{\"error\":\"Configuration receive timeout. Retry\"}"},
    {"{\"error\":\"操作参数无效\"}","{\"error\":\"Invalid operation parameters\"}"},
    {"{\"error\":\"操作失败，请重试\"}","{\"error\":\"Operation failed. Retry\"}"},
    {"{\"error\":\"文件名、格式或请求无效\"}","{\"error\":\"Invalid file name, format or request\"}"},
    {"{\"error\":\"文件或目录不存在\"}","{\"error\":\"File or folder not found\"}"},
    {"{\"error\":\"文件超过单文件上限\"}","{\"error\":\"File exceeds the per-file limit\"}"},
    {"{\"error\":\"文件路径无效\"}","{\"error\":\"Invalid file path\"}"},
    {"{\"error\":\"文件路径过长\"}","{\"error\":\"File path too long\"}"},
    {"{\"error\":\"无法遗忘网络，请重试\"}","{\"error\":\"Could not forget network. Retry\"}"},
    {"{\"error\":\"正在上传或切换网络，请稍后重试\"}","{\"error\":\"Uploading or switching networks. Retry shortly\"}"},
    {"{\"error\":\"正在传输，请完成后再设置签名\"}","{\"error\":\"Transfer active. Finish before setting a signature\"}"},
    {"{\"error\":\"目录不存在或无法读取\"}","{\"error\":\"Folder not found or unreadable\"}"},
    {"{\"error\":\"目录地址无效\"}","{\"error\":\"Invalid folder path\"}"},
    {"{\"error\":\"目录地址过长\"}","{\"error\":\"Folder path too long\"}"},
    {"{\"error\":\"目标文件已存在\"}","{\"error\":\"Target file already exists\"}"},
    {"{\"error\":\"签名保存或读取失败，请重试\"}","{\"error\":\"Could not save or read signature. Retry\"}"},
    {"{\"error\":\"签名最多95字节，不能含换行或控制字符\"}","{\"error\":\"Signature is limited to 95 bytes without line breaks or control characters\"}"},
    {"{\"error\":\"网络正在切换，请稍后重试\"}","{\"error\":\"Network switching. Retry shortly\"}"},
    {"{\"error\":\"网络正在切换，请连接后重试\"}","{\"error\":\"Network switching. Retry after connecting\"}"},
    {"{\"error\":\"网络配置正文长度无效\"}","{\"error\":\"Invalid network configuration body length\"}"},
    {"{\"error\":\"设备正忙，请稍后重试\"}","{\"error\":\"Device busy. Retry shortly\"}"},
    {"{\"error\":\"请从设备显示的地址打开\"}","{\"error\":\"Open the address shown on your device\"}"},
    {"{\"error\":\"请从设备显示的地址打开管理页面\"}","{\"error\":\"Open the management page from the address shown on your device\"}"},
    {"{\"error\":\"请在设备热点页面配置网络\"}","{\"error\":\"Configure the network on the device hotspot page\"}"},
    {"{\"error\":\"请插入 TF 卡后重试\"}","{\"error\":\"Insert a TF card and retry\"}"},
    {"{\"error\":\"连接中断或接收超时，请重试\"}","{\"error\":\"Connection interrupted or receive timeout. Retry\"}"},
    {"{\"error\":\"遗忘请求不应包含正文\"}","{\"error\":\"Forget requests must not contain a body\"}"},
    {"{\"error\":\"锁屏壁纸设置不可用\"}","{\"error\":\"Lock wallpaper setting unavailable\"}"},
    {"{\"error\":\"页码无效\"}","{\"error\":\"Invalid page number\"}"},
    {"« 10页","« 10 pages"},
    {"· 已闭环","· Goal met"},
    {"‹ 上页","‹ Previous"},
    {"↑ 升序","↑ Ascending"},
    {"↓ 降序","↓ Descending"},
    {"一","M"},
    {"三","W"},
    {"三本最近阅读，透过磨砂书夹显示","Three recent books behind frosted glass"},
    {"上 1/3：上一页","Top 1/3: previous"},
    {"上一","Previous"},
    {"上一步","Back"},
    {"上一页","Previous"},
    {"上一页 Prev","Previous"},
    {"上下、左右及 PageUp / PageDown 均可翻页","Arrow keys and PageUp / PageDown turn pages"},
    {"上下位置  %+d","Vertical offset  %+d"},
    {"上下翻页","Up / down"},
    {"上传失败，请重试","Upload failed. Retry"},
    {"上次打开此书时中断","Opening this book was interrupted"},
    {"上移 2px","Up 2px"},
    {"下 2/3：下一页","Bottom 2/3: next"},
    {"下一","Next"},
    {"下一页","Next"},
    {"下一页 Next","Next"},
    {"下移 2px","Down 2px"},
    {"下载","Download"},
    {"下载失败，请重试","Download failed. Retry"},
    {"下载完成，请返回选择字体","Downloaded. Go back to choose your font"},
    {"下载并准备","Download resources"},
    {"下页 ›","Next ›"},
    {"不全刷","Never"},
    {"不同步时，保留原来的阅读字体。","Otherwise, keep your current reading font."},
    {"不强制","Optional"},
    {"不操作","No action"},
    {"不显示","Hidden"},
    {"不格式化，不清除书籍和设置","No formatting or removal of books and settings"},
    {"不能移入自身文件夹","Cannot move a folder into itself"},
    {"不设功能","No action"},
    {"与手机或电脑连接同一个无线网络","Use the same Wi-Fi as your phone or computer"},
    {"两次输入不同，请重设","PINs do not match. Try again"},
    {"个人资料","Profile"},
    {"个性化功能","Personalisation"},
    {"中 / En","Zh / En"},
    {"中文","Chinese"},
    {"中文拼音","Chinese pinyin"},
    {"中断图书恢复","Interrupted book recovery"},
    {"中键","Middle key"},
    {"中键功能","Middle key action"},
    {"中键长按","Hold middle key"},
    {"中键长按功能","Middle hold action"},
    {"中键长按：手动全刷","Hold middle: Full refresh"},
    {"中键长按：返回主页","Hold middle: Home"},
    {"中间区域双击切换全屏 · 始终可用","Tap centre to switch immersion · Always available"},
    {"中间单击切换沉浸 · 始终可用","Tap centre to switch immersion · Always available"},
    {"中间单击进入全屏 · 上滑返回","Tap centre for fullscreen; swipe up to return"},
    {"中间单击进入全屏，底部上滑返回并显示工具栏","Tap centre for fullscreen; swipe up for tools"},
    {"主页刷新模式","Page refresh mode"},
    {"九宫格","9-key"},
    {"也可以跳过，稍后在设置中连接","You can skip and connect later in Settings"},
    {"书内自带字体","Embedded fonts"},
    {"书名","Book title"},
    {"书名 A 到 Z","Titles: A to Z"},
    {"书名 Z 到 A","Titles: Z to A"},
    {"书名不能为空","Book title cannot be empty"},
    {"书封、进度和阅读记录","Cover, progress and reading history"},
    {"书架","Bookshelf"},
    {"书架拼贴","Shelf collage"},
    {"书架排序","Bookshelf order"},
    {"书架排序：%s","Shelf order: %s"},
    {"书架样式","Shelf style"},
    {"书架管理","Manage shelf"},
    {"书签","Bookmarks"},
    {"书签保存失败","Could not save bookmark"},
    {"书签已添加","Bookmark added"},
    {"书签已移除","Bookmark removed"},
    {"书签开关","Toggle bookmark"},
    {"书籍","Books"},
    {"书籍、字体和图片仍需留在 TF 卡。","Keep books, fonts and images on the TF card."},
    {"书籍已删除","Book deleted"},
    {"二","T"},
    {"五","F"},
    {"亚克力书架","Acrylic shelf"},
    {"京华老宋","京华老宋"},
    {"亮度","Brightness"},
    {"亮度与色温","Brightness & warmth"},
    {"仅切换系统语言，书籍和输入内容保留原文","Only system text changes. Books and your input keep their original language"},
    {"仅支持 BLE 翻页器，按键只在阅读时生效","BLE pagers only. Keys work while reading"},
    {"仅显示前 128 张图片","Showing the first 128 images"},
    {"仅清阅读进度，保留图书文件","Clear progress and keep the book"},
    {"仅清阅读进度，所有文件保留","Clear reading progress and keep every file"},
    {"仅清除 WiFi 连接信息，不影响图书","Remove only Wi-Fi credentials, keeping your books"},
    {"仅系统字体","System only"},
    {"今天","Today"},
    {"今日阅读","Read today"},
    {"从 TF 卡恢复配置","Restore from TF card"},
    {"从书架移除","Remove from shelf"},
    {"从底部上滑可随时打开阅读工具栏","Swipe up from the bottom to open reading tools"},
    {"仓耳云黑05","仓耳云黑05"},
    {"以水波纹切换页面，保留灰阶","Ripple transitions with grayscale retained"},
    {"以锁屏前当前页面为背景","Use the current page as the background"},
    {"仿宋","仿宋"},
    {"传书 Transfer","Transfer"},
    {"传输","Transfer"},
    {"传输完成后，新内容会自动出现在书架或字体列表。","New content appears on the shelf or in the font list after upload."},
    {"传输未完成，请检查网络后重试","Transfer incomplete. Check network and retry"},
    {"传输正在结束，请稍后再试","Transfer is stopping. Retry shortly"},
    {"作者与进度 · 每页 4 本","Author & progress · 4 books per page"},
    {"作者未知","Unknown author"},
    {"你好。","Hello."},
    {"使用 TF 卡中的 JPG / PNG 图片","Use JPG / PNG images from the TF card"},
    {"使用此字体","Use this font"},
    {"使用此样式","Use this style"},
    {"使用背景","Use background"},
    {"使用透明书封","Use transparent cover"},
    {"使用默认图标","Use default icon"},
    {"依次尝试降频、单线等兼容方式","Try lower speeds, single-line mode and other compatible settings"},
    {"保存","Save"},
    {"保存与恢复","Save & restore"},
    {"保存与恢复配置","Save & restore"},
    {"保存失败，请检查 TF 卡剩余空间","Could not save. Check free card space"},
    {"保存失败，请检查书名或存储","Could not save. Check the title and storage"},
    {"保存失败，请检查设置存储空间","Could not save. Check settings storage space"},
    {"保存失败，请重试","Could not save. Try again"},
    {"保存失败，输入已保留，请重试","Could not save. Your input is kept. Retry"},
    {"保存当前配置到 TF 卡","Save settings to TF card"},
    {"保存时间","Save time"},
    {"保存未完成，请再试一次","Not saved yet. Please try again"},
    {"保存的凭据暂不可用，请重新输入密码","Saved credentials unavailable. Enter the password again"},
    {"保留书籍、字体、图片、阅读记录和硬件校准。","Keep books, fonts, images, reading history and hardware calibration."},
    {"保留灰阶层次，兼顾画面清晰度","Keep grayscale detail and clear text"},
    {"信号一般","Fair signal"},
    {"信号强","Strong signal"},
    {"信号良好","Good signal"},
    {"修改和关闭密码需验证原密码","Verify the current PIN to change or disable it"},
    {"修改密码","Change PIN"},
    {"停止传输服务","Stop transfer service"},
    {"像素 · 每次 1/16","Pixels · Steps of 1/16"},
    {"先查本地，再选择传入或下载","Use local fonts, transfer or download"},
    {"先浅后深","Light then deep sleep"},
    {"先浅睡，10 分钟后深睡","Light sleep, then deep sleep after 10 minutes"},
    {"全刷一次","Full refresh"},
    {"全屏沉浸","Immersive mode"},
    {"全选本页","Select this page"},
    {"全部书籍","All books"},
    {"全部来源","All sources"},
    {"全键盘","Full keyboard"},
    {"六","S"},
    {"共 %d 款","%d fonts"},
    {"共 %u 本","%u books"},
    {"共 %u 本 · 已选 %u 本","%u books · %u selected"},
    {"共 %u 项","%u items"},
    {"关机前保存进度并同步 RTC","Save progress and sync RTC before power-off"},
    {"关机睡眠","Power & sleep"},
    {"关闭","Off"},
    {"关闭书内图片","Hide book images"},
    {"关闭密码","Disable PIN"},
    {"其他书籍和设置会保留。","Other books and settings are kept."},
    {"内存不足，仅列 %d 本；释放后重扫","Low memory: listing %d books. Free space and rescan"},
    {"内存不足，复制失败","Not enough memory to copy"},
    {"内存不足，无法保留删除重试记录","Not enough memory to retain deletion retries"},
    {"内存不足，无法保留待保存进度","Not enough memory to retain unsaved progress"},
    {"内存不足，无法开始升级","Not enough memory to start update"},
    {"内存不足，无法打开图书","Not enough memory to open this book"},
    {"内存不足，暂用英文键盘","Low memory. Using the English keyboard for now"},
    {"内存不足，请关闭图书后重试","Not enough memory. Close the book and retry"},
    {"内存不足，请减少选择后重试","Not enough memory. Select fewer items and retry"},
    {"内存不足，请稍后重试","Not enough memory. Retry shortly"},
    {"内存不足，请缩短拼音后重试","Low memory. Shorten the pinyin and retry"},
    {"内存不足，请重启后重试","Not enough memory. Restart and retry"},
    {"内存卡已恢复挂载","Memory card mounted again"},
    {"内存卡恢复","Card recovery"},
    {"内存已清理，请点下方按钮重试","Memory cleared. Tap below to retry"},
    {"内置","Internal"},
    {"内置余","Internal free"},
    {"内置存储","Internal storage"},
    {"内置存储单本限 1 MB","Internal storage: maximum 1 MB per book"},
    {"内置按键","Default keys"},
    {"内置灰阶测试图","Built-in grayscale test"},
    {"再次点按，确认恢复配置","Tap again to confirm restore"},
    {"写入中断，当前版本保持不变","Write interrupted. Current version retained"},
    {"冷光","Cool"},
    {"准","准"},
    {"准备 BOOT 下载口","Prepare BOOT port"},
    {"准备中","Preparing"},
    {"准备失败，请重试","Preparation failed. Retry"},
    {"准备好字体","Prepare your fonts"},
    {"准备离线阅读资源","Prepare offline reading"},
    {"准备资源","Preparing resources"},
    {"准备默认字体与许可证","Prepare the font and its license"},
    {"凭据读取失败，请重启后重试","Cannot read credentials. Restart and retry"},
    {"分","Min"},
    {"分钟","min"},
    {"切换全屏","Toggle immersion"},
    {"切换时钟样式","Clock style"},
    {"列表书架","List shelf"},
    {"删除","Delete"},
    {"删除书籍","Delete books"},
    {"删除后文件无法恢复","Deleted files cannot be recovered"},
    {"删除后无法恢复，是否继续？","Deletion cannot be undone. Continue?"},
    {"删除后需要重新导入这本书。","You will need to import this book again after deleting it."},
    {"删除失败，请重试","Could not delete. Try again"},
    {"删除失败，请重试或用文件管理处理","Could not delete. Retry or use Files"},
    {"删除已选 · %u","Delete selected · %u"},
    {"删除所选 %u 项？","Delete %u selected items?"},
    {"删除文件","Delete file"},
    {"删除文件不可撤销，失败项可重试","Deletion is permanent. Failed items can be retried"},
    {"删除未完成，请检查 TF 卡","Deletion incomplete. Check the TF card"},
    {"删除这本书","Delete book"},
    {"删除选中的书签？","Delete selected bookmarks?"},
    {"前光","Frontlight"},
    {"前光与振动","Light & vibration"},
    {"前光开关","Toggle frontlight"},
    {"前往传输  ›","Open transfer  ›"},
    {"前往文件管理重命名","Rename in Files"},
    {"功能","Functions"},
    {"加密网络密码至少 8 个字符","Encrypted networks require at least 8 password characters"},
    {"加载失败，请检查存储卡后重试","Could not load. Check the card and retry"},
    {"包含阅读记录、设备资料和已存 WiFi。","Includes reading history, profile and saved Wi-Fi."},
    {"北京时间 · 24小时制","Beijing time · 24-hour clock"},
    {"北京时间 · UTC+8","Beijing time · UTC+8"},
    {"升级包不属于当前 Metalio S31 固件","Update does not belong to this Metalio S31 firmware"},
    {"升级包不属于当前 kiikoread 固件","Update does not belong to this kiikoread firmware"},
    {"升级包不是有效的 Metalio S31 固件","Not a valid Metalio S31 firmware image"},
    {"升级包不是有效的 kiikoread 固件","Not a valid kiikoread firmware image"},
    {"升级包与当前版本相同","Update has the same version as current firmware"},
    {"升级包为空","Update package is empty"},
    {"升级包已通过初步检查","Update passed preliminary checks"},
    {"升级包放在 TF 卡根目录","Put the update in the TF card root"},
    {"升级包无法读取","Cannot read update package"},
    {"升级包版本信息无效","Invalid update version information"},
    {"升级包超过固件分区容量","Update exceeds the firmware partition capacity"},
    {"升级和恢复","Updates & recovery"},
    {"升级期间请保持供电","Keep power connected while updating"},
    {"单击","Tap"},
    {"原因：%s","Reason: %s"},
    {"原密码不正确，请重试","Incorrect current PIN. Retry"},
    {"原选字体未能加载，请重新选择","Could not load the selected font. Select it again"},
    {"双击电源键解锁","Double-press power to unlock"},
    {"双击解锁","Double-press unlock"},
    {"发现新版本","Update available"},
    {"取消","Cancel"},
    {"取消下载","Cancel download"},
    {"取消下载？","Cancel download?"},
    {"取消准备","Cancel preparation"},
    {"取消删除","Keep book"},
    {"取消移动","Cancel move"},
    {"取消联网更新","Cancel online update"},
    {"口令：","Password:"},
    {"只修改书架显示名称","Change only its shelf display name"},
    {"只删除书签，不影响阅读进度","Only bookmarks are removed, not reading progress"},
    {"只移出书架，文件与阅读进度都保留","Hide from the shelf, keeping files and progress"},
    {"只需准备一次，以后随时离线阅读","Prepare once. Read offline anytime"},
    {"可尝试重启后重新选择","Try restarting, then select your font again"},
    {"可能是开书时断电或解析异常。","Power may have failed, or the book could not be parsed."},
    {"可输入中文、完整拼音、首字母或英文","Search Chinese, pinyin, initials or English"},
    {"右 1/2：下一页","Right side: next"},
    {"右侧：下一页","Right side: next"},
    {"右键","Right key"},
    {"右键功能","Right key action"},
    {"同一网络，手机或电脑传入","Transfer from a phone or computer on the same network"},
    {"同名文件会覆盖；完成后自动更新书架","Matching names overwrite files; shelf updates after transfer"},
    {"同名文件已经存在","A file with this name already exists"},
    {"同时适用于导入字体和书内字体","Applies to imported and embedded fonts"},
    {"同步到阅读字体？","Use for reading too?"},
    {"同步阅读字体","Use for reading"},
    {"同网浏览器上传 · 已完成 %u 本","Browser upload on same network · %u books completed"},
    {"名称","Name"},
    {"名称过长，无法在设备上编辑","Name too long to edit on this device"},
    {"启动中…","Starting..."},
    {"启动恢复","Startup recovery"},
    {"启动记录保存失败，请重试","Could not save startup checkpoint. Retry"},
    {"启用蓝牙","Enable Bluetooth"},
    {"四","T"},
    {"四位数字密码","Four-digit PIN"},
    {"固件完整性校验失败","Firmware integrity check failed"},
    {"图书 Books","Books"},
    {"图书已更新，旧待保存进度已作废","Book updated. Stale pending progress was discarded"},
    {"图书放入 TF 卡的 books 文件夹后会自动出现在书架。","Books in the TF card's books folder appear on your shelf automatically."},
    {"图书结构异常或资源超限","Invalid book structure or resource limit exceeded"},
    {"图书详情","Book details"},
    {"图书资源过大或章节过多","Book resources too large or too many chapters"},
    {"图片","Images"},
    {"图片列表内存不足，请返回后重试","Not enough memory for the image list. Go back and retry"},
    {"图片对比 Images","Images"},
    {"图片无法解码或内存不足，请换一张","Cannot decode image or not enough memory. Try another"},
    {"图片无法预览","Cannot preview image"},
    {"图片格式不支持","Unsupported image format"},
    {"图片超过 50 MB 或无法读取","Image exceeds 50 MB or is unreadable"},
    {"图片路径无法打开，请重新选择","Cannot open image path. Select it again"},
    {"圆圈全屏 · 左回首页 · 右工具栏","Circle: immerse · Left: home · Right: tools"},
    {"圆圈工具栏 · 左上一页 · 右下一页","Circle: tools · Left: back · Right: next"},
    {"圆圈键","Circle key"},
    {"圆圈键功能","Circle key action"},
    {"圆圈键长按","Hold circle key"},
    {"圆圈键长按功能","Circle hold action"},
    {"圆圈键长按：手动全刷","Hold circle: Full refresh"},
    {"圆圈键长按：返回主页","Hold circle: Home"},
    {"圆形表盘，十二个月相刻度","Round dial with twelve moon-phase markers"},
    {"圆滑短底座，清晰数字表盘","Rounded base with a clear digital dial"},
    {"在线字体","Online fonts"},
    {"增加 10%","Increase 10%"},
    {"壁纸","Wallpaper"},
    {"壁纸锁屏","Wallpaper lock"},
    {"备","备"},
    {"备份含 WiFi 密码，请妥善保管 TF 卡。","Backups contain Wi-Fi passwords. Keep the card safe."},
    {"复制","Copy"},
    {"复制失败，请检查空间","Copy failed. Check free space"},
    {"大","Large"},
    {"大小","Size"},
    {"子文件夹搜索完成，共 %u 项","Folder search complete: %u items"},
    {"字体","Font"},
    {"字体保存在存储卡，不占用固件空间","Fonts are saved on the card, outside firmware"},
    {"字体保存失败，请重试","Could not save font. Retry"},
    {"字体加载失败，请检查文件","Cannot load font. Check the file"},
    {"字体排版失败，请重新打开图书","Font layout failed. Reopen the book"},
    {"字体排版失败，请重试","Font layout failed. Try again"},
    {"字体文件大小不符","Font file size does not match"},
    {"字体无法加载","Cannot load font"},
    {"字体许可证","Font license"},
    {"字体设置","Font settings"},
    {"字体设置保存失败，请重试","Could not save system font. Retry"},
    {"字体重排失败，请重新打开图书","Font reflow failed. Reopen the book"},
    {"字重","Weight"},
    {"字间距","Letter spacing"},
    {"存储不可用，请检查 TF 卡","Storage unavailable. Check the TF card"},
    {"存储卡","Memory card"},
    {"存储已移除，传书已停止","Storage removed. Transfer stopped"},
    {"存储或传输正在使用，请稍后重试","Storage or transfer busy. Retry shortly"},
    {"存储未就绪，请插卡后重试","Storage not ready. Insert the card and retry"},
    {"学习","Learn"},
    {"安装 TF 卡升级包","Install TF update"},
    {"安装完成，即将重新启动","Installed. Restarting shortly"},
    {"宋体","宋体"},
    {"完全断电，长按电源键开机","Fully off. Hold the power key to turn on"},
    {"完成","Done"},
    {"完成 %u 项%s%u 项","Done %u items%s%u items"},
    {"完成传输","Finish transfer"},
    {"完成对时后开始记录每天的阅读时长","Daily reading time is recorded after time is set"},
    {"完成引导","Finish setup"},
    {"密码","Password"},
    {"密码不正确，请重试","Incorrect PIN. Try again"},
    {"密码使用英文、数字与符号","Use English letters, numbers and symbols for passwords"},
    {"密码须 8–63 字符或 64 位十六进制","Use 8–63 characters or 64 hexadecimal digits"},
    {"寒蝉正楷","寒蝉正楷"},
    {"对时成功后由内部时钟持续走时；无需保持联网。","After syncing, the internal clock keeps time without Wi-Fi."},
    {"导入图书","Import books"},
    {"封面任务正在收尾，请稍后再试","Cover task is finishing. Try again shortly"},
    {"封面任务正在收尾，请稍后重试","Cover task is finishing. Try again shortly"},
    {"将删除文件夹内所有内容，无法恢复","All contents of this folder will be deleted permanently"},
    {"将清空卡内全部数据，再点确认","All card data will be erased. Tap again to confirm"},
    {"小","Small"},
    {"小屋时钟","House clock"},
    {"尖屋顶、圆形开口，四个数字刻度","Peaked roof, round opening and four numerals"},
    {"尚无正在传输的文件","No file transferring"},
    {"尚无阅读进度","No reading progress yet"},
    {"尚未保存网络","No saved network"},
    {"尚未连接网络","Not connected"},
    {"尚未选择 WiFi","No Wi-Fi selected"},
    {"尚未配置","Not configured"},
    {"屏幕中间单击切换沉浸，不受按键设置影响","Tap the centre to switch immersion, independent of key settings"},
    {"屏幕中间双击切换全屏，不受按键设置影响","Tap the centre to switch immersion, independent of key settings"},
    {"屏幕修复","Screen cleanup"},
    {"屏幕修复中…","Cleaning screen..."},
    {"屏幕修复完成；若条纹仍在可再做一次","Cleanup complete. Repeat if stripes remain"},
    {"屏幕输出未完成，请稍后重试","Screen output incomplete. Retry later"},
    {"左 1/2：上一页","Left side: previous"},
    {"左上一页 · 中工具栏 · 右下一页","Left: back · Middle: tools · Right: next"},
    {"左侧：上一页","Left side: previous"},
    {"左右滑动切换图片 · 点按设置壁纸","Swipe to switch images · Tap to set wallpaper"},
    {"左右滑动切换图片 · 点按设置透明书封","Swipe to switch images · Tap for transparent cover"},
    {"左右滑动均可翻页","Swipe left or right to turn pages"},
    {"左右翻页","Left / right"},
    {"左回首页 · 中全屏 · 右工具栏","Left: home · Middle: immerse · Right: tools"},
    {"左键","Left key"},
    {"左键功能","Left key action"},
    {"已下载","Downloaded"},
    {"已书签","Bookmarked"},
    {"已保存","Saved"},
    {"已保存 · 可直连","Saved · Tap to connect"},
    {"已保存 · 尚未连接","Saved · Not connected"},
    {"已保存到 TF 卡根目录","Saved to TF card root"},
    {"已保存密码 · 可直连","Password saved · Tap to connect"},
    {"已保存的 WiFi","Saved Wi-Fi"},
    {"已保存网络","Saved network"},
    {"已保存，尚未连接","Saved, not connected"},
    {"已停止自动重试，可先返回首页。","Automatic retries stopped. You can return Home."},
    {"已关闭","Disabled"},
    {"已关闭，蓝牙内存已释放","Disabled. Bluetooth memory released"},
    {"已删除该配对","Pairing removed"},
    {"已删除，可返回首页","Deleted. You can return Home"},
    {"已删除，阅读记录清理失败","Deleted, but reading history cleanup failed"},
    {"已取消下载","Download cancelled"},
    {"已取消学习","Learning cancelled"},
    {"已在此文件夹","Already in this folder"},
    {"已复制：%.74s","Copied: %.74s"},
    {"已多次回退到内建字体","Repeatedly fell back to the built-in font"},
    {"已应用","Applied"},
    {"已开启","Enabled"},
    {"已开启，尝试连接上次设备","Enabled. Reconnecting to the last device"},
    {"已挂载，正在重新识别字体…","Mounted. Scanning fonts again..."},
    {"已断开，连接信息保留","Disconnected. Credentials kept"},
    {"已用 %s","Used %s"},
    {"已用 %s · 可用 %s","Used %s · Free %s"},
    {"已移出书架 %u 本，失败 %u 本%s","Removed %u books; failed %u%s"},
    {"已获取网络时间，内部时钟写入失败","Network time received, but internal clock write failed"},
    {"已设为书籍目录","Set as books folder"},
    {"已设为壁纸锁屏","Set as lock wallpaper"},
    {"已设为字体目录","Set as fonts folder"},
    {"已设为系统字体","Set as system font"},
    {"已设为透明书封","Set as transparent cover"},
    {"已识别 %d 款导入字体","Found %d imported fonts"},
    {"已读","Read"},
    {"已读 %u%%","Read %u%%"},
    {"已读完 · %u%%","Finished · %u%%"},
    {"已跳转到本章指定页","Jumped to the selected chapter page"},
    {"已连接","Connected"},
    {"已连接 %s","Connected to %s"},
    {"已连接 %u 台 · 已完成 %u 本","%u devices connected · %u books completed"},
    {"已连接，可以继续","Connected. You can continue"},
    {"已连接，可传书和对时","Connected for transfer and time sync"},
    {"已选 %u 项","%u selected"},
    {"已选择「%s」","Selected \"%s\""},
    {"已选择图片  ›","Image selected  ›"},
    {"已遗忘网络","Network forgotten"},
    {"已配对","Paired"},
    {"年","Year"},
    {"应用","Apply"},
    {"开启","On"},
    {"开启后可配对蓝牙翻页器；关闭会释放蓝牙内存","Enable to pair a pager; disable to release Bluetooth memory"},
    {"开启密码","Enable PIN"},
    {"开启透明书封锁屏？","Enable transparent cover lock?"},
    {"开始恢复","Start recovery"},
    {"开始更新","Update now"},
    {"开放网络","Open network"},
    {"开放网络保存失败，请重试","Could not save open network. Retry"},
    {"开放网络，无需密码","Open network. No password required"},
    {"张","images"},
    {"当前","Current"},
    {"当前  ✓","Current  ✓"},
    {"当前书籍","Current book"},
    {"当前使用","In use"},
    {"当前固件没有可用的 OTA 分区","No usable OTA partition in the current firmware"},
    {"当前图片无法设定","Cannot use this image"},
    {"当前壁纸","Current wallpaper"},
    {"当前字体保留","Your current font is kept"},
    {"当前文件夹","Current folder"},
    {"当前文件夹用途","Folder purpose"},
    {"当前时间 · 北京时间","Current time · Beijing time"},
    {"当前版本","Current version"},
    {"当前第 %u 页，点按数字可输入页码","Page %u. Tap the number to enter a page"},
    {"当前筛选没有图书","No books match this filter"},
    {"当前网络","Current network"},
    {"当前选择 · %s  %d/%d","Selected · %s  %d/%d"},
    {"当前阅读位置","Current position"},
    {"当前页面作底 · 白底 PNG 自动去白","Current page below · Remove white PNG background"},
    {"彻底关机","Complete power-off"},
    {"彻底断电","Power off"},
    {"待准备","Pending"},
    {"快刷","Fast"},
    {"思源黑体","思源黑体"},
    {"思源黑体（TF 卡）","思源黑体（TF 卡）"},
    {"思源黑体（内建）","思源黑体（内建）"},
    {"总容量 %s","Total %s"},
    {"恢复下载口","Restore port"},
    {"恢复出厂设置","Factory reset"},
    {"恢复将覆盖当前设置，请再点按一次确认","Restore replaces your settings. Tap again to confirm"},
    {"恢复居中","Centre"},
    {"恢复未完成，可稍后重试","Recovery incomplete. Retry later"},
    {"恢复未完成，请稍后重试：%s","Recovery incomplete. Retry later: %s"},
    {"恢复未完成，请重试","Restore incomplete. Retry"},
    {"成功 %u 本，失败 %u 本%s","Completed %u books; failed %u%s"},
    {"所选字体目录中没有可用字体","No usable fonts in the selected folder"},
    {"手动全刷","Full refresh"},
    {"手动设置","Set manually"},
    {"手机与墨水屏连接同一网络","Connect your phone to the same Wi-Fi"},
    {"手机或电脑扫码后，即可在浏览器上传内容","Scan with a phone or computer to upload in your browser"},
    {"打开一本书后，会在这里继续阅读","Open a book to continue reading here"},
    {"打开传书网页","Open transfer page"},
    {"扫描失败，请点下方按钮重试","Scan failed. Tap below to retry"},
    {"扫描已停止","Scan stopped"},
    {"扫描没有完成","Scan incomplete"},
    {"扫描设备","Scan devices"},
    {"扫码 Wi-Fi 传入字体","Transfer fonts over Wi-Fi"},
    {"找到 %u 项，仅显示前 %u 项","Found %u items; showing the first %u"},
    {"把官网升级包放入 TF 卡根目录","Put the website update package in the TF card root"},
    {"抗锯齿","Antialiasing"},
    {"拼音过长，请先选词","Pinyin too long. Choose a word first"},
    {"挂卡与字体","Card & fonts"},
    {"挂卡失败或字体未显示时，可手动重试","Retry manually if the card or fonts are missing"},
    {"按书名排列","Sort by book title"},
    {"按你的习惯排列","Arrange your shelf"},
    {"按最后阅读顺序排列","Sort by last reading time"},
    {"按百分比跳转","Jump by percentage"},
    {"按键控制","Key controls"},
    {"按键映射","Key mapping"},
    {"按首次收录顺序排列","Sort by first import time"},
    {"换机或刷机后，快速恢复个性化设置","Restore your preferences after changing devices or flashing"},
    {"排列文件","Sort files"},
    {"排列方向","Order direction"},
    {"排序依据","Sort by"},
    {"排序：%s %s","Sort: %s %s"},
    {"排版失败，请重新扫描并打开图书","Layout failed. Rescan and reopen the book"},
    {"排版失败，请重试","Layout failed. Try again"},
    {"排版失败：内存不足或章节过长","Layout failed: not enough memory or chapter too long"},
    {"排版设置","Layout"},
    {"推荐设置 %u","Preset %u"},
    {"搜索","Search"},
    {"搜索中","Filtered"},
    {"搜索书籍","Search books"},
    {"搜索图书","Find books"},
    {"搜索文件","Search files"},
    {"操作后重新计时，传输和升级期间暂停","Restarts after input; paused during transfer and updates"},
    {"支持 2.4 GHz WiFi（信道 1–13）","2.4 GHz Wi-Fi supported (channels 1–13)"},
    {"支持英文、数字、符号和空格","English letters, numbers, symbols and spaces"},
    {"收藏保存失败","Could not save favourite"},
    {"放入 Metalio-S31-update.bin","Copy Metalio-S31-update.bin"},
    {"效果预览","Preview"},
    {"文件","Files"},
    {"文件不可读，请检查 TF 卡和书籍文件","Cannot read file. Check the card and book"},
    {"文件删除失败，请检查存储后重试","Could not delete file. Check storage and retry"},
    {"文件名","File name"},
    {"文件名过长","File name too long"},
    {"文件大小","File size"},
    {"文件夹","Folder"},
    {"文件夹始终优先","Folders always come first"},
    {"文件夹已删除","Folder deleted"},
    {"文件存放位置","Where to put files"},
    {"文件将从存储卡删除，无法撤销","Files will be deleted from the card permanently"},
    {"文件已保存，但旧阅读进度清理失败；请重试清理进度","File saved, but old progress cleanup failed. Retry clearing progress"},
    {"文件已删除","File deleted"},
    {"文件已删除，但阅读进度清理失败；请重试清理进度","File deleted, but progress cleanup failed. Retry clearing progress"},
    {"文件已删除，进度清理失败，请重试","File deleted, but progress cleanup failed. Retry"},
    {"文件时间","File time"},
    {"文件校验或安装失败","Verification or installation failed"},
    {"文件格式或压缩方式暂不支持","Unsupported file format or compression"},
    {"文件管理","Files"},
    {"文件管理 Files","Files"},
    {"文字已达到长度上限","Text length limit reached"},
    {"文字排版、设备资料、阅读记录与书签","Text layout, profile, reading history and bookmarks"},
    {"文楷","文楷"},
    {"断开","Disconnect"},
    {"新书已保存，旧书备份清理失败；备份已保留，请勿重复上传","New book saved; old backup cleanup failed. Backup kept. Do not upload again"},
    {"无","None"},
    {"无操作后自动锁屏","Lock automatically after inactivity"},
    {"无法准备空闲固件分区","Cannot prepare the inactive firmware partition"},
    {"无法切换到新固件","Cannot select the new firmware"},
    {"无法开始升级，请退出传书后重试","Cannot start update. Exit file transfer and retry"},
    {"无法打开图书，请检查文件","Cannot open book. Check the file"},
    {"无法搜索当前文件夹","Cannot search this folder"},
    {"无法确认TF可用空间","Cannot determine free card space"},
    {"无法连接字体下载源","Cannot connect to the font download source"},
    {"无线网络","Wi-Fi networks"},
    {"无背景","No background"},
    {"日","S"},
    {"日期","Day"},
    {"日期与时间","Date & time"},
    {"日期未设置","Date not set"},
    {"时","Hour"},
    {"时间","Time"},
    {"时间已保存，并同步到电源管理芯片","Time saved and synced to the power controller"},
    {"星期一","Monday"},
    {"星期三","Wednesday"},
    {"星期二","Tuesday"},
    {"星期五","Friday"},
    {"星期六","Saturday"},
    {"星期四","Thursday"},
    {"星期日","Sunday"},
    {"是否让阅读正文也使用这个字体？","Use this font for reading text as well?"},
    {"显示","Display"},
    {"显示、连接与设备","Display, network and device"},
    {"显示在设置页的资料卡","Shown on your Settings profile card"},
    {"显示密码","Show"},
    {"普通","Normal"},
    {"暂不可用","Unavailable"},
    {"暂不支持","Unsupported"},
    {"暂不重启","Later"},
    {"暂无图书，请传入 TXT 或 EPUB","No books yet. Transfer TXT or EPUB files"},
    {"暂无图片","No images"},
    {"暂无已配对设备","No paired devices"},
    {"暖光","Warm"},
    {"暖光比例","Warmth"},
    {"更多","More"},
    {"更换头像","Change avatar"},
    {"最新添加的排在前面","Newest additions first"},
    {"最早添加的排在前面","Oldest additions first"},
    {"最近 30 天","Last 30 days"},
    {"最近读过的排在前面","Recently read first"},
    {"最近阅读","Last read"},
    {"最近阅读书夹","Recently read"},
    {"月","Month"},
    {"月阅读记录","Monthly reading"},
    {"服务启动后显示访问地址","The address appears after the service starts"},
    {"服务已开启","Service running"},
    {"未保存 · ","Not saved · "},
    {"未分类","Uncategorised"},
    {"未发现字体","No local fonts found"},
    {"未发现网络，请靠近路由器后重扫","No networks found. Move closer to the router and rescan"},
    {"未命名","Untitled"},
    {"未导入字体，阅读界面可能出现方格字","No font imported; some reading text may appear as boxes"},
    {"未开始 · %u%%","Not started · %u%%"},
    {"未找到图片，请放入 TF 卡的 pictures 文件夹","No images. Add them to the TF card's pictures folder"},
    {"未找到图片，请放入 pictures 文件夹","No images found. Add images to pictures"},
    {"未找到配置备份文件","No settings backup found"},
    {"未挂载","Not mounted"},
    {"未知","Unknown"},
    {"未设置","Not set"},
    {"未识别到 TF 卡，请插卡后重试","No TF card detected. Insert it and retry"},
    {"未识别拼音，请继续输入或重输","Pinyin not recognised. Keep typing or retype"},
    {"未读","Unread"},
    {"未连接","Not connected"},
    {"未配置","Not configured"},
    {"本","books"},
    {"本书进度","Book progress"},
    {"本地字体 · 已发现 %u 款","Local fonts · %u found"},
    {"本次更新","This update"},
    {"本次更新暂无说明","No notes available for this update"},
    {"本次阅读","This session"},
    {"本章","This chapter"},
    {"本章跳转","Jump in chapter"},
    {"本页全选","Select page"},
    {"松","Loose"},
    {"柔和","Soft"},
    {"柔软轮廓，弯曲的罗马数字","Soft outline with curved Roman numerals"},
    {"查看书签 · %u","Bookmarks · %u"},
    {"查看卡内文件夹","Browse folders"},
    {"查看目录，打开或管理已有图书","Browse, open and manage your books"},
    {"标准","Standard"},
    {"标准保留字体原始笔画","Standard keeps the font's original strokes"},
    {"格式化失败：%s","Format failed: %s"},
    {"检查更新","Check updates"},
    {"楷体","楷体"},
    {"欢迎使用 kiikoread","Welcome to kiikoread"},
    {"款","fonts"},
    {"正在下载","Downloading"},
    {"正在下载，短暂断网会自动重连","Downloading. Brief connection losses reconnect automatically"},
    {"正在传输，请完成后再断开","Transfer active. Finish before disconnecting"},
    {"正在传输，请完成后再连接","Transfer active. Finish before connecting"},
    {"正在传输，请完成后再遗忘","Transfer active. Finish before forgetting this network"},
    {"正在准备","Preparing"},
    {"正在准备 TF 卡","Preparing TF card"},
    {"正在准备传书…","Preparing transfer..."},
    {"正在准备许可证","Preparing license"},
    {"正在准备资源","Preparing resources"},
    {"正在删除","Deleting"},
    {"正在卸载本机 TF 卡并启动 USB…","Unmounting the TF card and starting USB..."},
    {"正在安装，请勿断电","Installing. Do not disconnect power"},
    {"正在恢复…","Resetting..."},
    {"正在扫描 2.4 GHz WiFi","Scanning 2.4 GHz Wi-Fi"},
    {"正在接收","Receiving"},
    {"正在搜索…已找到 %u 台","Searching... %u found"},
    {"正在搜索子文件夹，已找到 %u 项","Searching subfolders: %u items found"},
    {"正在校验","Verifying"},
    {"正在格式化…","Formatting..."},
    {"正在生成二维码…","Generating QR code..."},
    {"正在移动","Moving"},
    {"正在等待存储任务结束…","Waiting for storage tasks to finish..."},
    {"正在统计空间，文件可正常使用","Calculating space. Files are still usable"},
    {"正在获取网络时间…","Getting network time..."},
    {"正在进入","Entering"},
    {"正在连接 %s…","Connecting to %s..."},
    {"正在连接WiFi","Connecting Wi-Fi"},
    {"正在连接…","Connecting..."},
    {"正在连接已保存网络…","Connecting to saved network..."},
    {"正在连接并检查更新","Connecting and checking for updates"},
    {"正在释放内存卡资源…","Releasing memory-card resources..."},
    {"正在重启","Restarting"},
    {"正在重新挂载，请勿拔卡…","Remounting. Do not remove the card..."},
    {"此插图暂无法显示","This illustration is unavailable"},
    {"此版本仅支持 TXT 和 EPUB 书籍","This version supports TXT and EPUB books only"},
    {"此目录还没有文件","This folder is empty"},
    {"此网络认证暂不支持，请选择其他网络","Unsupported authentication. Choose another network"},
    {"段距","Paragraphs"},
    {"每 %u 页","Every %u pages"},
    {"每日闭环目标","Daily reading goal"},
    {"每页 9 本","9 books per page"},
    {"水波纹","Ripple"},
    {"没有发现可用网络","No available networks found"},
    {"没有可用的打开方式","No supported way to open this file"},
    {"浅睡10分钟后关机","Power off after 10 min light sleep"},
    {"浅睡可唤醒；关机后重新开机","Wake from light sleep; restart after power-off"},
    {"浅睡后关机","Sleep then power off"},
    {"浅睡时按键直接返回，深睡时会重新开机。","Keys return directly from light sleep; deep sleep restarts."},
    {"浏览 TF 卡","Browse TF card"},
    {"浏览器传书支持 EPUB、TXT、字体和图片文件。","Browser transfer supports EPUB, TXT, fonts and images."},
    {"液态玻璃书架","Liquid glass shelf"},
    {"深灰放射图案，白色指针配细描边","Dark radial pattern and outlined white hands"},
    {"深色书轨","Dark shelf"},
    {"添加时间","Date added"},
    {"添加翻页器","Add pager"},
    {"清晰","Clear"},
    {"清理进度","Clear progress"},
    {"清空","Clear"},
    {"清进度","Clear progress"},
    {"清除勾选","Clear selection"},
    {"清除条纹","Clear stripes"},
    {"清除进度：","Clear progress:"},
    {"源","源"},
    {"滑动关机","Slide to power off"},
    {"滚滚长江东逝水","滚滚长江东逝水"},
    {"灰阶测试图 / TF 卡 JPG PNG","Grayscale test / TF card JPG PNG"},
    {"点上方 + 或下方 − 调整数字","Tap + above or - below to adjust"},
    {"点下方按钮自动重试","Tap below to retry automatically"},
    {"点击应用","Tap to apply"},
    {"点击选择长按功能，例如返回主页","Choose a hold action, such as Home"},
    {"点按跳转到此处","Tap to jump here"},
    {"点按选择","Tap to select"},
    {"点此卡片重新扫描","Tap this card to rescan"},
    {"点此选择本地字体","Tap to choose a local font"},
    {"点线","Dotted"},
    {"点选卷名，展开该卷目录","Tap a volume to expand its contents"},
    {"热点传书","Hotspot transfer"},
    {"热点传书未启动","Hotspot transfer not started"},
    {"热点传输","Hotspot transfer"},
    {"热点就绪后显示访问地址","The address appears when the hotspot is ready"},
    {"热点或已有 WiFi，浏览器上传","Upload in a browser over hotspot or existing Wi-Fi"},
    {"状态","Status"},
    {"状态栏中间显示，留空则隐藏","Shown in the status bar. Leave empty to hide"},
    {"状态栏签名","Status signature"},
    {"猫眼左右转动，没有尾巴","Cat eyes move side to side, without a tail"},
    {"用 USB 数据线连接电脑","Connect to a computer with a USB data cable"},
    {"用于官网完整刷机或故障恢复","For a full website installation or recovery"},
    {"用于本机 S31 固件更新或故障恢复","Update or recover this S31 device's firmware"},
    {"用于系统字体","For system UI"},
    {"用于阅读字体","For reading"},
    {"由墨水屏创建临时网络，离线也能传书","The reader creates a temporary network for offline transfer"},
    {"电源菜单滑动关机始终直接断电","The power-menu shutdown slider always powers off directly"},
    {"电源键翻页","Power to turn"},
    {"电脑刷机","Computer flashing"},
    {"电脑将触发下载模式；等待时可返回退出。","The computer triggers download mode. You can go back while waiting."},
    {"电脑已连接","Computer connected"},
    {"电脑确认 S31 身份后，才表示进入 ROM。","ROM mode is confirmed only after the computer identifies S31."},
    {"界面文字大小","Interface text size"},
    {"百分比跳转","Jump by percentage"},
    {"目录","Contents"},
    {"目录不存在：%.60s","Folder not found: %.60s"},
    {"目录路径过长","Folder path too long"},
    {"目标位置","Destination"},
    {"目标已有同名项目","An item with this name already exists"},
    {"目标路径过长","Target path too long"},
    {"省电选项见“关机睡眠”","See Power & sleep for power-saving options"},
    {"真实封面 · 名称与数量 · 系统字体","Real covers · Titles & count · System font"},
    {"短时针、长分针，圆点为秒针","Short hour, long minute and dot second hands"},
    {"确定","OK"},
    {"确认","Confirm"},
    {"确认 TF 卡升级","Confirm TF update"},
    {"确认删除","Delete"},
    {"确认删除文件？","Delete this file?"},
    {"确认删除这本书？","Delete this book?"},
    {"确认升级","Confirm update"},
    {"确认后将恢复默认设置并重启。","Confirm to restore defaults and restart."},
    {"确认后，短按电源键将显示此图片","After confirming, a short power press shows this image"},
    {"确认恢复并重启","Reset & restart"},
    {"确认清除","Clear"},
    {"确认清除进度？","Clear reading progress?"},
    {"确认遗忘","Forget"},
    {"磁盘名称  SD_CARD","Drive name  SD_CARD"},
    {"移出书架","Remove"},
    {"移动","Move"},
    {"移动到此处","Move here"},
    {"移动失败，请检查 TF 卡","Move failed. Check the TF card"},
    {"移动完成","Move complete"},
    {"移动至","Move to"},
    {"稍后","Later"},
    {"空格","Space"},
    {"空间统计暂不可用，请重新进入此页","Space info unavailable. Reopen this page"},
    {"立即同步  ›","Sync now  ›"},
    {"立即重启","Restart now"},
    {"竖排（从右到左）","Vertical (right to left)"},
    {"章"," chapter"},
    {"章节","Chapters"},
    {"章节 %u","Chapter %u"},
    {"符号","Symbols"},
    {"第","Chapter "},
    {"第 %d / %d 页　Page %d / %d","Page %d / %d · %d / %d"},
    {"第 %d 页 · 共 %d 页","Page %d · %d pages"},
    {"第 %u 卷","Volume %u"},
    {"第 %u 节","Section %u"},
    {"第 %u 页","Page %u"},
    {"等待 USB 连接，可点击上方按钮重新检测","Waiting for USB. Tap above to detect it again"},
    {"等待上传","Waiting for upload"},
    {"等待电脑连接","Waiting for computer"},
    {"等待网络地址…","Waiting for network address..."},
    {"简体中文","Simplified Chinese"},
    {"管理","Manage"},
    {"系统升级","System update"},
    {"系统字体","System font"},
    {"系统字号","Text size"},
    {"系统对比度","System contrast"},
    {"系统时间已设置，PMU 同步失败","System time set, but PMU sync failed"},
    {"紧","Tight"},
    {"累计 %llu 小时 %llu 分钟","Total %llu h %llu min"},
    {"约第 %d / %d 页 · 第 %u～%u 节","About page %d / %d · Sections %u–%u"},
    {"约第 %d / %d 页 · 第 %u～%u 行","About page %d / %d · Lines %u–%u"},
    {"结束 USB 读卡","End USB drive"},
    {"统计中","Calculating"},
    {"继续","Continue"},
    {"继续下载","Continue download"},
    {"继续阅读 ›","Continue reading ›"},
    {"继续阅读与月阅读记录","Continue reading and monthly activity"},
    {"编辑","Edit"},
    {"编辑  ›","Edit  ›"},
    {"编辑书籍","Edit book"},
    {"缩进微调","Indent adjustment"},
    {"网络对时失败，请检查网络后重试","Time sync failed. Check the network and retry"},
    {"网络对时超时，请检查网络后重试","Time sync timed out. Check the network and retry"},
    {"网络已停止","Network stopped"},
    {"网络正在结束，请稍后再试","Network is stopping. Retry shortly"},
    {"翻页","Page turns"},
    {"翻页效果","Page effect"},
    {"翻页模式","Tap direction"},
    {"联网 OTA","Online OTA"},
    {"联网下载字体","Download fonts"},
    {"背景","Background"},
    {"背景预览","Background preview"},
    {"脚注","Footnote"},
    {"自动休眠锁屏","Auto lock"},
    {"自动全刷","Full refresh"},
    {"自定义三键","Customise keys"},
    {"自定义名称与头像","Customise your name and avatar"},
    {"英文大写","Uppercase"},
    {"英文密码","English password"},
    {"英文小写","Lowercase"},
    {"英语","English"},
    {"蓝牙正在忙，请稍后重试","Bluetooth busy. Try again shortly"},
    {"蓝牙翻页器","Bluetooth pager"},
    {"薄玻璃挡条 · 每页 9 本","Thin glass rails · 9 books per page"},
    {"虚线","Dashed"},
    {"行距","Line spacing"},
    {"解码失败或内存不足","Decode failed or not enough memory"},
    {"解锁宽限期","Unlock grace period"},
    {"触摸振动","Touch vibration"},
    {"许可证下载或校验失败","Could not download or verify the license"},
    {"设为书籍目录","Use for books"},
    {"设为壁纸锁屏？","Use as lock wallpaper?"},
    {"设为字体目录","Use for fonts"},
    {"设为锁屏壁纸","Use as lock wallpaper"},
    {"设备名称","Device name"},
    {"设备名称不能为空","Device name cannot be empty"},
    {"设备已连接；手机需同网","Device connected; phone must use the same network"},
    {"设定未完成，请重试","Could not apply. Retry"},
    {"设置","Settings"},
    {"设置 Settings","Settings"},
    {"设置、阅读记录与 TF 卡文件保留","Settings, reading history and TF card files are kept"},
    {"设置了锁屏密码时仍需验证","An enabled lock PIN still requires verification"},
    {"设置四位密码  ›","Set a four-digit PIN  ›"},
    {"设置路径过长","Settings path too long"},
    {"设置路径过长，无法移动","Settings path too long to move"},
    {"识别成功 · 已收到翻页器按键","Recognised · Pager key received"},
    {"识别成功 · 已绑定上一页","Recognised · Previous page assigned"},
    {"识别成功 · 已绑定下一页","Recognised · Next page assigned"},
    {"识别成功 · 绑定保存失败，请重试","Recognised · Could not save mapping. Retry"},
    {"语言","Language"},
    {"语言、网络与字体","Language, network and fonts"},
    {"语言保存失败，请重试","Could not save language. Retry"},
    {"请从下方列表选择 2.4 GHz WiFi","Choose a 2.4 GHz Wi-Fi network below"},
    {"请先在 WiFi 设置中配置网络","Configure a network in Wi-Fi settings first"},
    {"请先在WiFi设置中连接网络","Connect a network in Wi-Fi settings first"},
    {"请先完成WiFi对时","Sync time over Wi-Fi first"},
    {"请先完成日期与时间设置","Set the date and time first"},
    {"请先开启蓝牙翻页器","Enable the Bluetooth pager first"},
    {"请先开启蓝牙，再删除配对","Enable Bluetooth before removing a pairing"},
    {"请先恢复存储卡，或跳过引导","Restore the memory card, or skip setup"},
    {"请先挂载内存卡","Mount the memory card first"},
    {"请先插入TF卡","Insert a TF card first"},
    {"请先设置日期与时间","Set date and time first"},
    {"请先输入拼音并选择词语","Enter pinyin and choose a word first"},
    {"请先进入 TF 卡内的文件夹","Open a folder on the TF card first"},
    {"请先连接翻页器再学习按键","Connect a pager before learning keys"},
    {"请先退出传书、USB读卡和升级，再重试","Exit transfer, USB drive and updates before retrying"},
    {"请先选择候选字","Select a candidate first"},
    {"请先选择图书","Select books first"},
    {"请先选择文件","Select files first"},
    {"请先选择词语，再保存","Choose a word before saving"},
    {"请先选词或重输，再切换键盘","Choose a word or retype before switching keyboard"},
    {"请先选词，再切换语言","Choose a word before switching language"},
    {"请先选词，再输入数字符号","Choose a word before entering numbers or symbols"},
    {"请在 pictures 中放入 JPG 或 PNG 图片","Put JPG or PNG images in pictures"},
    {"请将 %s 字体放入所选字体目录","Put the %s font in the selected font folder"},
    {"请按翻页器上「上一页」要用的键","Press the key you want to use for Previous page"},
    {"请按翻页器上「下一页」要用的键","Press the key you want to use for Next page"},
    {"请检查 TF 卡","Check the TF card"},
    {"请检查卡是否插好，或更换内存卡","Check the card connection, or try another card"},
    {"请用 USB 连接电脑，再打开官网刷机页","Connect USB to a computer, then open the website installer"},
    {"请等待 10 秒后重试","Wait 10 seconds before retrying"},
    {"请等待后重试","Wait, then retry"},
    {"请输入 1—%u 之间的页码","Enter a page from 1 to %u"},
    {"请输入有效文件名","Enter a valid file name"},
    {"请重新输入","Enter again"},
    {"请靠近路由器后重新扫描","Move closer to the router and rescan"},
    {"调整系统界面的灰阶层次与清晰度","Adjust grayscale detail and interface clarity"},
    {"调整阅读文字粗细","Adjust stroke weight"},
    {"资","资"},
    {"资源保存在 SD 卡，完成后可离线使用","Saved on the SD card for offline use"},
    {"资源已准备好","Resources are ready"},
    {"资源正在使用，请稍后重试","Resources busy. Try again shortly"},
    {"跳到目录位置","Jump in contents"},
    {"跳转","Jump"},
    {"跳转到本章","Jump within chapter"},
    {"跳过引导","Skip setup"},
    {"跳过正文插图，保留原书文件","Skip inline images and keep the original book"},
    {"轻点切换，最大 200%","Tap to cycle, up to 200%"},
    {"轻点此处返回蓝牙开关","Tap here to return to Bluetooth settings"},
    {"轻点输入，可切换大小写","Tap to type; switch letter case as needed"},
    {"较后的项目排在前面","Later items first"},
    {"较早的项目排在前面","Earlier items first"},
    {"较早读过的排在前面","Earlier reading first"},
    {"输入完成后连接，密码只保存在本机","Connect when ready. Passwords stay on this device"},
    {"输入密码","Enter PIN"},
    {"边距","Margins"},
    {"边距 · 行距","Margins · Line spacing"},
    {"达到目标的日期会显示下划线","Days meeting your goal are underlined"},
    {"返回","Back"},
    {"返回主页","Go home"},
    {"返回字体列表","Back to fonts"},
    {"返回字体设置","Back to fonts"},
    {"返回引导","Back to setup"},
    {"返回文件管理","Back to Files"},
    {"返回章节","Back to chapters"},
    {"返回跳转前","Go back"},
    {"返回首页","Home"},
    {"还没有保存书签","No bookmarks yet"},
    {"这本书没有可用目录","No usable contents for this book"},
    {"进入 BOOT 模式","Enter BOOT mode"},
    {"进度保存失败，请重试","Could not save progress. Try again"},
    {"进度清理失败，请重新尝试","Could not clear progress. Retry"},
    {"连接","Connect"},
    {"连接  ›","Connect  ›"},
    {"连接 USB 后准备下载口，再到电脑检查连接","Connect USB, prepare the port, then check on your computer"},
    {"连接 Wi-Fi","Connect to Wi-Fi"},
    {"连接 WiFi","Connect Wi-Fi"},
    {"连接 WiFi，优先检查 GitHub 新版本","Connect Wi-Fi and check GitHub for updates first"},
    {"连接 WiFi，检查官网发布的新版本","Connect Wi-Fi to check the official website for updates"},
    {"连接 kiikoread 热点","Join the kiikoread hotspot"},
    {"连接 kiikoread 热点后上传图书","Join the kiikoread hotspot to upload books"},
    {"连接与时间","Network & time"},
    {"连接中…","Connecting..."},
    {"连接后可传书和对时","Connect for transfer and time sync"},
    {"连接后，可退出此页继续使用。","After connecting, you can return to the device."},
    {"连接启动失败，请重试","Could not start connection. Retry"},
    {"连接失败，请检查密码或信号","Connection failed. Check password and signal"},
    {"连接失败，请重试","Connection failed. Retry"},
    {"连接并保存","Connect & save"},
    {"连接成功","Connected"},
    {"连接或更改网络","Connect or change network"},
    {"连接状态","Connection status"},
    {"连接电脑，把图书放入 books 文件夹","Connect a computer and copy books to books"},
    {"连接网络，传入书籍和完整字体","Connect for books and complete fonts"},
    {"连接阅读器热点，无需路由器","Join the reader's hotspot without a router"},
    {"连续输入拼音，选择词语","Type pinyin and choose a word"},
    {"退出此页后，WiFi 仍保持连接。","Wi-Fi stays connected after leaving this page."},
    {"退格","Backspace"},
    {"选定后同时用于系统字体和阅读字体","Use your selection for system and reading"},
    {"选择","Select"},
    {"选择  ›","Choose  ›"},
    {"选择 Wi-Fi 网络","Choose a Wi-Fi network"},
    {"选择书架外观与排列方式","Choose the shelf appearance and layout"},
    {"选择你喜欢的样式","Choose your favourite style"},
    {"选择卷","Choose volume"},
    {"选择壁纸","Choose wallpaper"},
    {"选择头像","Choose avatar"},
    {"选择字体","Choose font"},
    {"选择完整字库","Choose a complete font"},
    {"选择导入方式","Choose an import method"},
    {"选择方式","Choose a method"},
    {"选择本地字体","Choose a local font"},
    {"选择样式","Choose a style"},
    {"选择电源菜单中“关机”的方式","Choose how Shut down in the power menu behaves"},
    {"选择电源键锁屏后的画面","Choose what appears when the power key locks"},
    {"选择百分比，先预览目标位置","Choose a percentage to preview the destination"},
    {"选择目标文件夹","Choose target folder"},
    {"选择短按与自动锁屏后的省电方式","Power saving after a short press or auto lock"},
    {"选择短按功能 · 书签仅在阅读中生效","Choose a short-press action · Bookmarks work while reading"},
    {"选择虚线或点线后可调整位置","Choose dashed or dotted to adjust its position"},
    {"选择透明书封","Choose transparent cover"},
    {"选词","Choose word"},
    {"透明 PNG 书封","Transparent PNG cover"},
    {"透明书封","Transparent cover"},
    {"透明书封放入 pictures · 推荐 684 × 1216","Put transparent covers in pictures · 684 × 1216 recommended"},
    {"透明书封请选择 PNG 图片","Choose a PNG for transparent covers"},
    {"通过 U 盘或 Wi-Fi 导入 TF 卡","Transfer to the TF card via USB or Wi-Fi"},
    {"通过 WiFi 对时","Sync over Wi-Fi"},
    {"速读黑白","Fast B&W"},
    {"遗忘失败，请重试或取消","Could not forget. Retry or cancel"},
    {"遗忘网络","Forget network"},
    {"部分文件过大或名称过长，未列入","Some files were omitted due to size or name length"},
    {"部分目录或文件不可读，请检查后重扫","Some folders or files are unreadable. Check and rescan"},
    {"部分目录未能读取，已找到 %u 项","Some folders could not be read; found %u items"},
    {"配网后可在日期与时间中进行 WiFi 对时。","After connecting, use Date & time to sync over Wi-Fi."},
    {"配置","Settings"},
    {"配置与阅读记录已恢复","Settings and reading history restored"},
    {"配置与阅读记录已恢复；WiFi 请重新连接","Settings and history restored. Reconnect Wi-Fi"},
    {"配置保存失败，请重试","Could not save setup. Retry"},
    {"配置备份文件","Settings backup file"},
    {"配置文件损坏或版本不兼容","Backup damaged or version incompatible"},
    {"重启","Restart"},
    {"重启前将保存阅读进度","Reading progress will be saved before restart"},
    {"重命名","Rename"},
    {"重命名失败，请检查 TF 卡","Rename failed. Check the TF card"},
    {"重命名完成","Renamed"},
    {"重新恢复下载口","Restore download port again"},
    {"重新扫描","Rescan"},
    {"重新检查 TF 卡","Check TF card again"},
    {"重新检测内存卡与导入字体","Detect the memory card and imported fonts again"},
    {"重新进入传书可使用内置存储","Reopen transfer to use internal storage"},
    {"重置系统","Reset system"},
    {"重置系统偏好、资料卡、WiFi、蓝牙配对和锁屏密码。","Reset preferences, profile, Wi-Fi, Bluetooth pairings and lock PIN."},
    {"重试扫描","Rescan"},
    {"重试清理","Retry cleanup"},
    {"重试热点传书","Retry hotspot transfer"},
    {"重输","Retype"},
    {"锁屏先浅睡，10 分钟后进入深睡","Light sleep first, then deep sleep after 10 minutes"},
    {"锁屏密码","Lock PIN"},
    {"锁屏密码已保存","Lock PIN saved"},
    {"锁屏密码已关闭","Lock PIN disabled"},
    {"锁屏样式","Lock screen style"},
    {"锁屏样式同时适用于壁纸与阅读票根。","Lock styles apply to wallpapers and reading tickets."},
    {"锁屏画面保留；深睡后短按电源键开机","Lock image stays; short press restarts after deep sleep"},
    {"锁屏设置暂不可用","Lock settings unavailable"},
    {"长按文件或文件夹打开操作","Hold a selected file or folder for more actions"},
    {"长按电源键开机","Hold power to turn on"},
    {"长时间离线可能产生误差，建议定期重新对时。","Time may drift while offline. Sync again periodically."},
    {"阅读字体","Reading font"},
    {"阅读字体保存失败，请重试","Could not save reading font. Retry"},
    {"阅读字体加载异常","Reading font error"},
    {"阅读工具栏","Reading tools"},
    {"阅读文字 Aa 123","Reading Aa 123"},
    {"阅读时点按“书签”即可保存当前位置","Tap Bookmark while reading to save your place"},
    {"阅读票根","Reading ticket"},
    {"阅读线","Reading guide"},
    {"阅读统计","Reading stats"},
    {"阅读背景","Reading background"},
    {"阅读设置","Reading settings"},
    {"阅读进度","Progress"},
    {"阅读进度 %u%%","Reading progress %u%%"},
    {"阅读，让时间慢下来","Read. Let time slow down"},
    {"附近网络","Nearby networks"},
    {"附近还没有发现设备","No nearby devices found yet"},
    {"降低 10%","Decrease 10%"},
    {"隐藏","Hide"},
    {"需要密码","Password required"},
    {"需要格式化","Format required"},
    {"页","page"},
    {"预览壁纸","Wallpaper preview"},
    {"预览透明书封","Cover preview"},
    {"首次安装或修复，请通过官网完整刷机","For a first install or recovery, use the full website installer"},
    {"首次引导 Setup","Setup"},
    {"首行缩进","First-line indent"},
    {"首页","Home"},
    {"首页 Home","Home"},
    {"首页 · 书架 · 文件管理 · 设置","Home · Bookshelf · Files · Settings"},
    {"首页强刷","Home full refresh"},
    {"首页组件","Home widget"},
    {"验证原密码  ›","Verify current PIN  ›"},
    {"高对比","High contrast"},
    {"鲜明","Vivid"},
    {"黑体","黑体"},
    {"黑白快刷，亚克力用细棋盘格","Fast B&W, with fine checkerboard acrylic"},
    {"默认图标  ›","Default icon  ›"},
    {"默认系统字体","Default system font"},
    {"；所选可重试","; retry selected items"},
};
